## conf/layer.conf
```bitbake
BBPATH .= ":${LAYERDIR}"

BBFILES += "\
    ${LAYERDIR}/recipes-*/*/*.bb \
    ${LAYERDIR}/recipes-*/*/*.bbappend \
"

BBFILE_COLLECTIONS += "meta-raspberrypi-extra"
BBFILE_PATTERN_meta-raspberrypi-extra = "^${LAYERDIR}/"
BBFILE_PRIORITY_meta-raspberrypi-extra = "12"

LAYERDEPENDS_meta-raspberrypi-extra += "core raspberrypi"

LAYERSERIES_COMPAT_meta-raspberrypi-extra = "scarthgap"
```
